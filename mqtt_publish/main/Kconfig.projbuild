## mqtt_publish/main/Kconfig.projbuild
```kconfig
menu "Application Configuration"

	config MQTT_BROKER
		string "MQTT Broker"
		default "broker.emqx.io"
		help
			Host name or IP address of the broker to connect to

	config MQTT_PORT_TCP
		int "MQTT Port"
		range 0 65535
		default 1883
		help
			Port number of the broker to connect to.

	config MQTT_PUB_TOPIC
		string "Publish Topic"
		default "/topic/test"
		help
			Topic of publish

	config PUBLISH_INTERVAL
		int "Publish Interval(Second)"
		default 5
		help
			Set the Interval of Publish.

endmenu
```

## mqtt_subscribe/main/Kconfig.projbuild
```kconfig
menu "Application Configuration"

	config MQTT_BROKER
		string "MQTT Broker"
		default "broker.emqx.io"
		help
			Host name or IP address of the broker to connect to

	config MQTT_PORT_TCP
		int "MQTT Port"
		range 0 65535
		default 1883
		help
			Port number of the broker to connect to.

	config MQTT_SUB_TOPIC
		string "Subscribe Topic"
		default "/topic/test"
		help
			Topic of subscribe

endmenu
```

## setup/main/Kconfig.projbuild
```kconfig
menu "Application Configuration"

	config ESP_WIFI_SSID
		string "WiFi SSID"
		default "myssid"
		help
			SSID (network name) for the example to connect to.

	config ESP_WIFI_PASSWORD
		string "WiFi Password"
		default "mypassword"
		help
			WiFi password (WPA or WPA2) for the example to use.

	config MDNS_HOSTNAME
		string "mDNS Hostname"
		default "esp32-server"
		help
			The mDNS host name used by the ESP32.

endmenu
```

## sntp_client/main/Kconfig.projbuild
```kconfig
menu "Application Configuration"

	config NTP_SERVER
		string "NTP Server"
		default "pool.ntp.org"
		help
			Hostname for NTP Server.

	config TIMEZONE
		int "Your TimeZone"
		range -23 23
		default 0
		help
			Your local timezone.
			When it is 0, Greenwich Mean Time.

endmenu
```
